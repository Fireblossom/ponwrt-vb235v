// SPDX-License-Identifier: GPL-2.0-only
/dts-v1/;
/plugin/;

/* Development declaration for a patched PonWrt AN7583 tree.
 * Keep disabled: firmware/payload compatibility and hardware behavior
 * remain unverified. This overlay does not enable any peripheral.
 */
/ {
	fragment@0 {
		target-path = "/soc/npu@1e900000";
		__overlay__ {
			airoha,npu-layout = "an7583-v2p";
			/* Mailbox, six stock-observed watchdogs, six WLAN IRQs.
			 * Raw GIC SPI selectors, not Linux IRQ numbers.
			 */
			interrupts = <0 125 4>,
				     <0 134 4>, <0 135 4>, <0 136 4>,
				     <0 137 4>, <0 109 4>, <0 110 4>,
				     <0 118 4>, <0 119 4>, <0 120 4>,
				     <0 121 4>, <0 122 4>, <0 123 4>;
			status = "disabled";
		};
	};
};
